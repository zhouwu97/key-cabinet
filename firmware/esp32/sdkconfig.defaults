## firmware/esp32/sdkconfig.defaults
```kconfig
# ESP-IDF Target & Flash
CONFIG_IDF_TARGET="esp32"
CONFIG_ESPTOOLPY_FLASHSIZE_4MB=y

# FreeRTOS Configuration
CONFIG_FREERTOS_HZ=1000
CONFIG_ESP_MAIN_TASK_STACK_SIZE=8192

# Networking & MQTT
CONFIG_ESP_WIFI_ENABLED=y
CONFIG_MQTT_TRANSPORT_SSL=y
CONFIG_MQTT_TRANSPORT_WEBSOCKET=n

# Logging & Console
CONFIG_LOG_DEFAULT_LEVEL_INFO=y
```
